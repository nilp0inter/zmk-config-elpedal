## config/boards/shields/elpedal/Kconfig.defconfig
```kconfig
if SHIELD_ELPEDAL

config ZMK_KEYBOARD_NAME
    default "elpedal"

config ZMK_SETTINGS_RESET_ON_START
    default "y"

config ZMK_BLE_CLEAR_BONDS_ON_START
    default "y"

endif
```
