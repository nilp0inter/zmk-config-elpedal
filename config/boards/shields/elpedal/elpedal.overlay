/ {
    chosen {
        zmk,kscan = &default_kscan;
    };

    default_kscan: kscan {
        compatible = "zmk,kscan-gpio-direct";
        label = "default_kscan";
        toggle-mode;

        input-gpios =
            <&pro_micro 0 (GPIO_ACTIVE_LOW)>;
    };
};
